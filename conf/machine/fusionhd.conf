## conf/machine/fusionhd.conf
```bitbake
#@TYPE: Machine
#@NAME: fusionhd
#@DESCRIPTION: Machine configuration for the Xsarius fusionhd

IMAGEDIR ?= "update/fusionhd/cfe"

BRANDTYPE = "XSARIUS"

CHIPSET = "bcm7362"

require conf/machine/include/xsarius.inc

SOC_FAMILY = "bcm7362"

STB_PLATFORM = "dags7362"
```

## conf/machine/fusionhdse.conf
```bitbake
#@TYPE: Machine
#@NAME: fusionhdse
#@DESCRIPTION: Machine configuration for the Xsarius fusionhd

IMAGEDIR ?= "update/fusionhdse/cfe"

BRANDTYPE ?= "XSARIUS"

CHIPSET = "bcm7362"

require conf/machine/include/xsarius.inc

SOC_FAMILY = "bcm7362"

STB_PLATFORM = "dags7362"
```

## conf/machine/galaxy4k.conf
```bitbake
#@TYPE: Machine
#@NAME: xsarius galaxy4k
#@DESCRIPTION: Machine configuration for the revo4k.

CHIP = "7252S"

UPDATE_DIR = "galaxy4k"

require conf/machine/include/xsarius4k.inc

KV = "linux-3.14-28"

MACHINE_FEATURES += "textlcd dvbproxy dvb-c transcoding streamproxy"

CHIPSET = "bcm7439"

MODEL_SIZE = "300mm"

FORCE_REBOOT_OPTION = "reboot"

MACHINE_KERNEL_PR = "r1"

IMAGE_FSTYPES =+ "ext4"

MACHINE_ESSENTIAL_EXTRA_RDEPENDS += " \
	xsarius-dvb-modules-bcm7252s-${MODEL_SIZE} \
"

PREFERRED_VERSION_linux-xsarius = "3.14.28"
```

## conf/machine/include/xsarius-dvb-usb.inc
```bitbake
MACHINE_ESSENTIAL_EXTRA_RRECOMMENDS += " \
				firmware-dvb-usb-af9015 \
				firmware-dvb-fe-af9013 \
				firmware-dvb-usb-af9035-01 \ 
				firmware-dvb-usb-af9035-02 \
				firmware-as102-data1-st \
				firmware-as102-data2-st \
				firmware-xc3028-v27 \
				firmware-xc3028l-v36 \
				firmware-dvb-usb-wt220u-02 \
				firmware-dvb-usb-wt220u-fc03 \
				firmware-dvb-usb-wt220u-miglia-01 \
				firmware-dvb-usb-wt220u-zl0353-01 \
				firmware-dvb-usb-s660 \
				firmware-dvb-fe-ds3000 \
				firmware-dvb-fe-tda10071 \
				firmware-dvb-usb-it913x \
				firmware-dvb-siano \
				firmware-dvb-nova-12mhz-b0 \
				firmware-isdbt-nova-12mhz-b0 \
				firmware-dvb-usb-dib0700-1.20 \
				firmware-dvb-usb-dibusb-5.0.0.11 \
				firmware-dvb-usb-dibusb-6.0.0.8 \
				firmware-dvb-usb-dibusb-an2235-01 \
				firmware-xc3028-v27 \
				firmware-xc3028l-v36 \
				firmware-dvb-fe-tda10071 \
				firmware-af9005 \
				firmware-dvb-usb-dib0700-01 \
				firmware-dvb-usb-dib0700-03-pre1 \
				firmware-dvb-usb-dib0700-1.10 \
				firmware-dvb-usb-dtt200u-01 \
				firmware-dvb-usb-it9135 \
				firmware-rtl8192cu \
				firmware-rtl8712u \
				firmware-zd1211 \
				\
				kernel-module-dvb-usb-af9015 \
				kernel-module-dvb-usb-af9035 \
				kernel-module-af9033 \
				kernel-module-tua9001 \
				kernel-module-dib0090 \
				kernel-module-dib3000mb \
				kernel-module-dib3000mc \
				kernel-module-dibx000-common \
				kernel-module-mt2060 \
				kernel-module-dib7000m \
				kernel-module-dib7000p \
				kernel-module-dib0070 \
				kernel-module-dib8000 \
				kernel-module-tda10071 \
				kernel-module-dvb-usb-it913x \
				kernel-module-it913x-fe \
				kernel-module-smsusb \
				kernel-module-smsdvb \
				kernel-module-rtl2832 \
				kernel-module-dvb-usb-rtl28xxu \
				kernel-module-dvb-usb-dib0700 \
				kernel-module-dvb-usb-dibusb-common \
				kernel-module-dvb-usb-dibusb-mc \
				kernel-module-fc0013 \
				kernel-module-videobuf2-core \
				kernel-module-tveeprom \
				kernel-module-videobuf2-memops \
				kernel-module-videobuf2-vmalloc \
				kernel-module-em28xx \
				kernel-module-cxd2820r \
				kernel-module-tda10071 \
				kernel-module-usbserial \
				kernel-module-belkin-sa \
				kernel-module-pl2303 \
				kernel-module-ezusb \
				kernel-module-ftdi-sio \
				kernel-module-keyspan \
"
```

## conf/machine/include/xsarius-wifi.inc
```bitbake
MACHINE_ESSENTIAL_EXTRA_RRECOMMENDS += " \
	firmware-carl9170 \
	firmware-htc7010 \
	firmware-htc9271 \
	firmware-rt2870 \
	firmware-rt73 \
	firmware-rtl8712u \
	firmware-zd1211 \
	\
	kernel-module-ath9k-htc \
	kernel-module-carl9170 \
	kernel-module-r8712u \
	kernel-module-rt2500usb \
	kernel-module-rt2800usb \
	kernel-module-rt73usb \
	kernel-module-rtl8187 \
	kernel-module-zd1211rw \
	\
	kernel-module-rtl8188eu \
        kernel-module-rtl8192cu \
	\
	firmware-rtl8192cu \
"
```

## conf/machine/include/xsarius.inc
```bitbake
# We know about rtc
MACHINE_FEATURES_BACKFILL_CONSIDERED = "rtc"

include conf/machine/include/autoload-filesystems.inc

MACHINE_ESSENTIAL_EXTRA_RDEPENDS = " \
	xsarius-dvb-modules-${CHIPSET} \
	xsarius-kernel-params \
	xsarius-shutdown \
	ntfs-3g \
"

KERNEL_MODULE_AUTOLOAD += "xfs"

MACHINE_EXTRA_RRECOMMENDS = " \
	gstreamer1.0-libav \
	splash-bootlogo \
	xsarius-opera-dumpait \
	bcm \
"

EXTRA_IMAGEDEPENDS = " \
	splash-bootlogo \
"

TARGET_ARCH = "mipsel"
DEFAULTTUNE = "mips32el"

DVBMEDIASINK_CONFIG = "--with-xsarius --with-wmv --with-pcm --with-eac3 --with-h265"

PREFERRED_PROVIDER_virtual/kernel = "linux-xsarius"
PREFERRED_VERSION_linux-xsarius = "4.2.1"

IMAGE_FSTYPES ?= "ubi"

UBI_VOLNAME = "rootfs"
MKUBIFS_ARGS = "-m 2048 -e 126976 -c 4096 -F"
UBINIZE_ARGS = "-m 2048 -p 128KiB"

EXTRA_IMAGECMD_COMPAT = " --eraseblock=0x20000 -n -l --pagesize=0x800 "

UBI_IMAGEDIR = "${WORKDIR}/deploy-${PN}-image-complete"

IMAGE_CMD_ubi_prepend = " \
     				  mkdir -p ${DEPLOY_DIR_IMAGE}/${IMAGEDIR}/; \
                      cp -f ${IMAGE_ROOTFS}/tmp/vmlinux.gz ${DEPLOY_DIR_IMAGE}/${IMAGE_NAME}.vmlinux.gz; \
                      cp -f ${DEPLOY_DIR_IMAGE}/${MACHINE}_splash.bmp ${DEPLOY_DIR_IMAGE}/${IMAGEDIR}/splash.bmp; \
                      cp -f ${DEPLOY_DIR_IMAGE}/${MACHINE}_splash1.bmp ${DEPLOY_DIR_IMAGE}/${IMAGEDIR}/splash1.bmp; \
                      cp -f ${DEPLOY_DIR_IMAGE}/${MACHINE}_splash2.bmp ${DEPLOY_DIR_IMAGE}/${IMAGEDIR}/splash2.bmp; \
"

IMAGE_CMD_ubi_append = " \
	cp -f ${DEPLOY_DIR_IMAGE}/${IMAGE_NAME}.vmlinux.gz  ${DEPLOY_DIR_IMAGE}/${IMAGEDIR}/oe_kernel.bin; \
	cp -f ${UBI_IMAGEDIR}/${IMAGE_NAME}.rootfs.ubi ${DEPLOY_DIR_IMAGE}/${IMAGEDIR}/oe_rootfs.bin; \
	cd ${DEPLOY_DIR_IMAGE}; \
	zip ${IMAGE_NAME}_usb.zip ${IMAGEDIR}/*; \
	rm -rf update; \
"

MACHINE_FEATURES += "dvb-c alsa usbhost wlan kernelwifi 3dtv switchoff osdposition hdmicec dvbusb"

require conf/machine/include/tune-mips32.inc
require conf/machine/include/xsarius-wifi.inc
require conf/machine/include/xsarius-dvb-usb.inc
```

## conf/machine/include/xsarius4k.inc
```bitbake
# We know about rtc
MACHINE_FEATURES_BACKFILL_CONSIDERED = "rtc"

MTD_KERNEL = "mmcblk0p1"
TARGET_ARCH = "arm"
DEFAULTTUNE = "armv7ahf-neon"
MACHINE_ESSENTIAL_EXTRA_RDEPENDS = " \
	${@bb.utils.contains("GST_VERSION", "1.0", "gstreamer1.0-libav", "gst-ffmpeg", d)} \
        xsarius-initrd-${MACHINE} \
        xsarius-shutdown \
"

KERNEL_MODULE_AUTOLOAD += "xfs"

MACHINE_EXTRA_RRECOMMENDS = " \
	gstreamer1.0-plugin-dvbmediasink \
	ntfs-3g \
"

EXTRA_IMAGEDEPENDS += "\
	webkit-classic \
	dumpait-legacy \
	enigma2-plugin-extensions-hbbtv-webkit \
        splash-bootlogo \
"

DVBMEDIASINK_CONFIG = "--with-pcm --with-eac3 --with-amr --with-wmv --with-h265 --with-vb6 --with-vb8 --with-vb9 --with-spark"

PREFERRED_PROVIDER_virtual/kernel = "linux-xsarius"

IMAGE_FSTYPES ?= "tar.bz2"

PREFERRED_VERSION_directfb = "1.7.7"

IMAGEDIR ?= "${MACHINE}"

IMAGE_CMD_tar_prepend = " \
	mkdir -p ${DEPLOY_DIR_IMAGE}/update/${UPDATE_DIR}/; \
	cp -f ${DEPLOY_DIR_IMAGE}/${MACHINE}_splash.bmp ${DEPLOY_DIR_IMAGE}/update/${UPDATE_DIR}/splash.bmp; \
        cp ${IMAGE_ROOTFS}/tmp/zImage ${DEPLOY_DIR_IMAGE}/update/${MACHINE}/oe_kernel.bin; \
        cp ${IMAGE_ROOTFS}/boot/initrd_run.bin ${DEPLOY_DIR_IMAGE}/update/${UPDATE_DIR}/initrd_run.bin; \
        rm -rf ${IMAGE_ROOTFS}/tmp/zImage; \
        rm -rf ${IMAGE_ROOTFS}/boot/initrd_run.bin; \
        tar -cvf ${DEPLOY_DIR_IMAGE}/rootfs.tar -C ${IMAGE_ROOTFS} .; \
        mv ${DEPLOY_DIR_IMAGE}/rootfs.tar ${DEPLOY_DIR_IMAGE}/update/${UPDATE_DIR}/rootfs.tar; \
        bzip2 ${DEPLOY_DIR_IMAGE}/update/${MACHINE}/rootfs.tar; \
        cd ${DEPLOY_DIR_IMAGE}; \
        zip ${IMAGE_NAME}_usb.zip update/${UPDATE_DIR}/*; \
        rm -rf update; \
"

MACHINE_FEATURES += "alsa usbhost wlan kernelwifi extrakernelwifi 3dtv switchoff osdposition hdmicec"

require conf/machine/include/arm/arch-armv7a.inc
require conf/machine/include/xsarius-wifi.inc
require conf/machine/include/xsarius-dvb-usb.inc
```

## conf/machine/purehd.conf
```bitbake
#@TYPE: Machine
#@NAME: purehd
#@DESCRIPTION: Machine configuration for the Xsarius purehd

IMAGEDIR ?= "update/purehd/cfe"

BRANDTYPE = "XSARIUS"

CHIPSET = "bcm7362"

require conf/machine/include/xsarius.inc
```

## conf/machine/purehdse.conf
```bitbake
#@TYPE: Machine
#@NAME: purehd
#@DESCRIPTION: Machine configuration for the Xsarius purehd

IMAGEDIR ?= "update/purehdse/cfe"

BRANDTYPE = "XSARIUS"

CHIPSET = "bcm73625"

require conf/machine/include/xsarius.inc
```

## conf/machine/revo4k.conf
```bitbake
#@TYPE: Machine
#@NAME: xsarius revo4k
#@DESCRIPTION: Machine configuration for the revo4k.

CHIP = "7252S"

UPDATE_DIR = "revo4k"

require conf/machine/include/xsarius4k.inc

KV = "linux-3.14-28"

MACHINE_FEATURES += "hbbtv dvbproxy dvb-c"

CHIPSET = "bcm7439"

MODEL_SIZE = "200mm"

FORCE_REBOOT_OPTION = "reboot"

MACHINE_KERNEL_PR = "r1"

IMAGE_FSTYPES =+ "ext4"
```
